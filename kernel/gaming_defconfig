## kernel/gaming_defconfig
```kconfig
# nunu-kernel gaming defconfig
# Based on android-common GKI (android14-6.1) with gaming-focused tuning.
# References: sultan-kernel, Kirisakura (Pixel 7), arter97, Google Pixel gaming mode.
#
# Apply on top of arch/arm64/configs/gki_defconfig:
#   scripts/kconfig/merge_config.sh arch/arm64/configs/gki_defconfig kernel/gaming_defconfig

# ── CPU Scheduler ────────────────────────────────────────────────────────────
# EAS (Energy Aware Scheduling) — scheduler-driven CPU frequency decisions.
# Better task placement than PELT alone, used by all Pixel/Snapdragon GKI kernels.
CONFIG_ENERGY_MODEL=y

# WALT (Window-Assisted Load Tracking) — more accurate than PELT for bursty gaming loads.
# Tracks load in sliding windows rather than exponential decay.
CONFIG_SCHED_WALT=y

# schedutil: frequency governor driven directly by the scheduler.
# Faster response than ondemand/interactive — no polling, instant freq switch.
CONFIG_CPU_FREQ_GOV_SCHEDUTIL=y
CONFIG_CPU_FREQ_DEFAULT_GOV_SCHEDUTIL=y

# Disable legacy governors (reduce config surface, not needed in VM)
# CONFIG_CPU_FREQ_GOV_ONDEMAND is not set
# CONFIG_CPU_FREQ_GOV_CONSERVATIVE is not set
# CONFIG_CPU_FREQ_GOV_USERSPACE is not set

# SchedTune: per-cgroup CPU boost hints (used by Android to boost top-app)
CONFIG_SCHED_TUNE=y

# Fast frequency switching — allows scheduler to change freq in tick context,
# bypassing the normal cpufreq workqueue. Critical for low-latency gaming.
CONFIG_CPU_FREQ_GOV_SCHEDUTIL_FAST_SWITCH=y

# ── I/O Scheduler ────────────────────────────────────────────────────────────
# mq-deadline: lowest latency for random I/O (game asset loading).
# Better than BFQ for gaming — BFQ's fairness logic adds latency spikes.
CONFIG_MQ_IOSCHED_DEADLINE=y
CONFIG_DEFAULT_IOSCHED="mq-deadline"

# Disable CFQ — fairness-based, wrong tradeoff for gaming
# CONFIG_IOSCHED_CFQ is not set

# ── Memory Management ────────────────────────────────────────────────────────
# LRU Gen (MGLRU): improved page reclaim, reduces jank from memory pressure.
# Merged in Linux 6.1, used in Android 14 GKI.
CONFIG_LRU_GEN=y
CONFIG_LRU_GEN_ENABLED=y

# zRAM: compressed swap in RAM. Useful on physical devices.
# In a VM we control memory directly — disable to avoid compression overhead.
# CONFIG_ZRAM is not set
# CONFIG_ZSMALLOC is not set

# KSM (Kernel Samepage Merging): merge identical pages across processes.
# Games share a lot of read-only assets — can reclaim 200-400MB in practice.
CONFIG_KSM=y

# Transparent Huge Pages: reduce TLB pressure for large game heap allocations.
CONFIG_TRANSPARENT_HUGEPAGE=y
CONFIG_TRANSPARENT_HUGEPAGE_MADVISE=y

# ── Network ──────────────────────────────────────────────────────────────────
# BBR v2: better TCP congestion control for online games (lower latency under loss).
# Replaces default Cubic which backs off too aggressively.
CONFIG_TCP_CONG_BBR=y
CONFIG_DEFAULT_TCP_CONG="bbr"

CONFIG_NET_SCH_FQ=y          # Fair Queue — pairs with BBR for pacing
CONFIG_NET_SCH_FQ_CODEL=y    # FQ-CoDel — reduces bufferbloat in game traffic

# ── BPF ──────────────────────────────────────────────────────────────────────
# BPF JIT: required for Android 14 network stack, also used by game anti-cheat.
CONFIG_BPF_JIT=y
CONFIG_BPF_JIT_ALWAYS_ON=y
CONFIG_BPF_SYSCALL=y

# ── Virtualization (VM-specific) ─────────────────────────────────────────────
# VirtIO drivers — required to talk to Virtualization.framework host devices.
CONFIG_VIRTIO=y
CONFIG_VIRTIO_PCI=y
CONFIG_VIRTIO_BLK=y          # virtio-blk: disk images
CONFIG_VIRTIO_NET=y          # virtio-net: ADB networking
CONFIG_VIRTIO_GPU=y          # virtio-gpu: Metal-backed display
CONFIG_VIRTIO_INPUT=y        # virtio-input: touch/keyboard forwarding
CONFIG_VIRTIO_CONSOLE=y      # virtio-console: serial debug console
CONFIG_VIRTIO_BALLOON=y      # virtio-balloon: host-managed memory reclaim
CONFIG_DRM_VIRTIO_GPU=y      # DRM frontend for virtio-gpu

# ── Android-specific ─────────────────────────────────────────────────────────
CONFIG_ANDROID=y
CONFIG_ANDROID_BINDER_IPC=y
CONFIG_ANDROID_BINDERFS=y

# ION: Android's cross-process memory allocator (used by games for GPU buffers)
CONFIG_ION=y

# ashmem: shared memory (used by older games, keep for compatibility)
CONFIG_ASHMEM=y

# ── Security (minimal for VM context) ────────────────────────────────────────
# Keep SELinux — required for Android userspace, do not disable.
CONFIG_SECURITY_SELINUX=y

# ── Debug (disabled for performance) ─────────────────────────────────────────
# CONFIG_DEBUG_KERNEL is not set
# CONFIG_DEBUG_INFO is not set
# CONFIG_KASAN is not set
# CONFIG_UBSAN is not set
# CONFIG_KCSAN is not set
# CONFIG_FTRACE is not set
```
